## workspace/practice/esp32_02/main/Kconfig.projbuild
```kconfig
menu "Blinky Configuration"

    osource "$IDF_PATH/examples/common_components/env_caps/$IDF_TARGET/Kconfig.env_caps"

    config BLINKY_PIN
        int "Blinky GPIO Pin"
        range ENV_GPIO_RANGE_MIN ENV_GPIO_OUT_RANGE_MAX
        default 10
        help
            Set the GPIO Pin

    config BLINKY_PERIOD
        int "Blinky Perion in ms"
        range 10 3600000
        default 1000
        help
            Set the period cycle

endmenu
```

## workspace/practice/esp32_03/main/Kconfig.projbuild
```kconfig
menu "Stoplight Configurations"
    osource "$IDF_PATH/examples/common_components/env_caps/$IDF_TARGET/Kconfig.env_caps"

    menu "Stoplight Pins"
        config SLPIN_R
            int "GPIO pin for Red LED"
            range ENV_GPIO_RANGE_MIN ENV_GPIO_OUT_RANGE_MAX
            default 10
            help
                This is to set the pin for the Red LED
        config SLPIN_Y
            int "GPIO pin for Yellow LED"
            range ENV_GPIO_RANGE_MIN ENV_GPIO_OUT_RANGE_MAX
            default 9
            help
                This is to set the pin for the Yellow LED
        config SLPIN_G
            int "GPIO pin for Green LED"
            range ENV_GPIO_RANGE_MIN ENV_GPIO_OUT_RANGE_MAX
            default 46
            help
                This is to set the pin for the Green LED
        config SLPIN_RESET
            int "GPIO pin for reset button"
            range ENV_GPIO_RANGE_MIN ENV_GPIO_OUT_RANGE_MAX
            default 8
            help
                This is to set the pin for the reset button
    endmenu

    menu "Stoplight Time"
        config SLTIME_R
            int "Set time for Red LED in ms"
            range 1000 120000
            default 30000
            help
                This is to set the pin for the Red LED
        config SLTIME_Y
            int "Set time for Yellow LED in ms"
            range 1000 10000
            default 3000
            help
                This is to set the pin for the Yellow LED
        config SLTIME_G
            int "Set time for Green LED in ms"
            range 1000 120000
            default 30000
            help
                This is to set the pin for the Green LED
    endmenu

endmenu
```
